## components/libka/Kconfig
```kconfig
menu "Keycard Access extras"

    choice PN532_BLINK_GPIO
        prompt "PN532 GPIO high on activity"
        help
            You can set one of the PN532 GPIOs to high during keycard access activity.
        default PN532_BLINK_GPIO_NONE
        config PN532_BLINK_GPIO_NONE
            bool "None"
        config PN532_BLINK_GPIO_P3
            bool "Use PN532 bus 3"
        config PN532_BLINK_GPIO_P7
            bool "Use PN532 bus 7"
    endchoice

    if PN532_BLINK_GPIO_P3 || PN532_BLINK_GPIO_P7
        config PN532_BLINK_GPIO_NUM
            int "GPIO number on bus"
            range 0 9
            default 0
    endif
endmenu
```

## keycard-access/sdkconfig.defaults
```kconfig
CONFIG_MBEDTLS_DES_C=y
CONFIG_MAIN_TASK_STACK_SIZE=10240
CONFIG_PTHREAD_TASK_STACK_SIZE_DEFAULT=6144
CONFIG_PARTITION_TABLE_CUSTOM=y
```

## main/Kconfig
```kconfig
menu "Keycard Access"
    config PN532_HSU_TX
        int "GPIO connected to PN532 UART TX/I2C SDA line"
        range 0 39 if IDF_TARGET_ESP32
        range 0 20 if IDF_TARGET_ESP32C2
        range 0 21 if IDF_TARGET_ESP32C3
        range 0 30 if IDF_TARGET_ESP32C6
        range 0 27 if IDF_TARGET_ESP32H2
        range 0 56 if IDF_TARGET_ESP32P4
        range 0 46 if IDF_TARGET_ESP32S2
        range 0 48 if IDF_TARGET_ESP32S3
        default 18

    config PN532_HSU_RX
        int "GPIO connected to PN532 UART RX/I2C SCL line"
        range 0 39 if IDF_TARGET_ESP32
        range 0 20 if IDF_TARGET_ESP32C2
        range 0 21 if IDF_TARGET_ESP32C3
        range 0 30 if IDF_TARGET_ESP32C6
        range 0 27 if IDF_TARGET_ESP32H2
        range 0 56 if IDF_TARGET_ESP32P4
        range 0 46 if IDF_TARGET_ESP32S2
        range 0 48 if IDF_TARGET_ESP32S3
        default 19

    choice KEYCARD_ACCESS_FIRMWARE
        prompt "Firmware to build"
        help
            You can build either a gate or a keymaker
        default KEYCARD_ACCESS_FIRMWARE_KEYMAKER
        config KEYCARD_ACCESS_FIRMWARE_KEYMAKER
            bool "Keymaker"
        config KEYCARD_ACCESS_FIRMWARE_GATE
            bool "Gate"
    endchoice
endmenu
```

## tests/main/Kconfig
```kconfig
menu "Keycard Access tests"
    config PN532_HSU_TX
        int "GPIO connected to PN532 UART TX line"
        range 0 39 if IDF_TARGET_ESP32
        range 0 20 if IDF_TARGET_ESP32C2
        range 0 21 if IDF_TARGET_ESP32C3
        range 0 30 if IDF_TARGET_ESP32C6
        range 0 27 if IDF_TARGET_ESP32H2
        range 0 56 if IDF_TARGET_ESP32P4
        range 0 46 if IDF_TARGET_ESP32S2
        range 0 48 if IDF_TARGET_ESP32S3
        default 32 if IDF_TARGET_ESP32 || IDF_TARGET_ESP32C6 || IDF_TARGET_ESP32P4 || IDF_TARGET_ESP32S2 || IDF_TARGET_ESP32S3
        default 21 if IDF_TARGET_ESP32C2 || IDF_TARGET_ESP32C3 || IDF_TARGET_ESP32H2

    config PN532_HSU_RX
        int "GPIO connected to PN532 UART RX line"
        range 0 39 if IDF_TARGET_ESP32
        range 0 20 if IDF_TARGET_ESP32C2
        range 0 21 if IDF_TARGET_ESP32C3
        range 0 30 if IDF_TARGET_ESP32C6
        range 0 27 if IDF_TARGET_ESP32H2
        range 0 56 if IDF_TARGET_ESP32P4
        range 0 46 if IDF_TARGET_ESP32S2
        range 0 48 if IDF_TARGET_ESP32S3
        default 33 if IDF_TARGET_ESP32 || IDF_TARGET_ESP32C6 || IDF_TARGET_ESP32P4 || IDF_TARGET_ESP32S2 || IDF_TARGET_ESP32S3
        default 20 if IDF_TARGET_ESP32C2 || IDF_TARGET_ESP32C3 || IDF_TARGET_ESP32H2


    config PN532_CHANNEL_SELECTION
        bool "Control PN532 channel I0, I1 and RST"
        default y

    if PN532_CHANNEL_SELECTION
        config PN532_I0
            int "GPIO connected to PN532 I0 pin (channel selection)"
            range 0 39 if IDF_TARGET_ESP32
            range 0 20 if IDF_TARGET_ESP32C2
            range 0 21 if IDF_TARGET_ESP32C3
            range 0 30 if IDF_TARGET_ESP32C6
            range 0 27 if IDF_TARGET_ESP32H2
            range 0 56 if IDF_TARGET_ESP32P4
            range 0 46 if IDF_TARGET_ESP32S2
            range 0 48 if IDF_TARGET_ESP32S3
            default 23 if IDF_TARGET_ESP32 || IDF_TARGET_ESP32C6 || IDF_TARGET_ESP32P4 || IDF_TARGET_ESP32S2 || IDF_TARGET_ESP32S3
            default 4 if IDF_TARGET_ESP32C2 || IDF_TARGET_ESP32C3 || IDF_TARGET_ESP32H2

        config PN532_I1
            int "GPIO connected to PN532 I1 pin (channel selection)"
            range 0 39 if IDF_TARGET_ESP32
            range 0 20 if IDF_TARGET_ESP32C2
            range 0 21 if IDF_TARGET_ESP32C3
            range 0 30 if IDF_TARGET_ESP32C6
            range 0 27 if IDF_TARGET_ESP32H2
            range 0 56 if IDF_TARGET_ESP32P4
            range 0 46 if IDF_TARGET_ESP32S2
            range 0 48 if IDF_TARGET_ESP32S3
            default 22 if IDF_TARGET_ESP32 || IDF_TARGET_ESP32C6 || IDF_TARGET_ESP32P4 || IDF_TARGET_ESP32S2 || IDF_TARGET_ESP32S3
            default 5 if IDF_TARGET_ESP32C2 || IDF_TARGET_ESP32C3 || IDF_TARGET_ESP32H2

        config PN532_RSTN
            int "GPIO connected to PN532 RST pin (reset)"
            range 0 39 if IDF_TARGET_ESP32
            range 0 20 if IDF_TARGET_ESP32C2
            range 0 21 if IDF_TARGET_ESP32C3
            range 0 30 if IDF_TARGET_ESP32C6
            range 0 27 if IDF_TARGET_ESP32H2
            range 0 56 if IDF_TARGET_ESP32P4
            range 0 46 if IDF_TARGET_ESP32S2
            range 0 48 if IDF_TARGET_ESP32S3
            default 19 if IDF_TARGET_ESP32 || IDF_TARGET_ESP32C6 || IDF_TARGET_ESP32P4 || IDF_TARGET_ESP32S2 || IDF_TARGET_ESP32S3
            default 6 if IDF_TARGET_ESP32C2 || IDF_TARGET_ESP32C3 || IDF_TARGET_ESP32H2
    endif
endmenu
```
